## rtos/bsp/rockchip/common/drivers/display-serdes/Kconfig
```kconfig
menuconfig RT_USING_SERDES_DISPLAY_CHIP_MAXIM
    bool "maxim serdes device support"
    default n
    help
        Enable this to be able to choose the drivers for controlling the
        maxim serdes.

if RT_USING_SERDES_DISPLAY_CHIP_MAXIM

config RT_USING_SERDES_CHIP_MAXIM_MAX96752
    bool "maxim max96752 serdes"
    default y
    help
        To support maxim max96752 display serdes.

config RT_USING_SERDES_CHIP_MAXIM_MAX96789
    bool "maxim max96789 serdes"
    default y
    help
        To support maxim max96789 display serdes.

endif
```

## rtos/bsp/rockchip/rk2116/board/Kconfig
```kconfig
menu "RT-Thread board config"

config IS_FPGA
    bool "Is FPGA Board"
    default n

choice
    prompt "Board Type"
    default RT_USING_BOARD_FPGA

    config RT_USING_BOARD_FPGA
        bool "Enable FPGA board"
        select IS_FPGA

    config RT_USING_BOARD_EVB1_V10
        bool "Enable EVB1 V10 board"

    config RT_USING_BOARD_EVB2_V10
        bool "Enable EVB2 V10 board"

    config RT_USING_BOARD_IOTEST_V10
        bool "Enable IOTEST V10 board"

endchoice

config RT_USING_HIFI4
    bool "Enable hifi4 driver"
    default n

    if RT_USING_HIFI4
        config RT_USING_HIFI4_FW_BUILTIN
        bool "hifi4 firmware builtin"
        default n
    endif

source "$BSP_DIR/../common/fwmgr/Kconfig"
source "$RTT_DIR/components/hifi4/rtt/app/Kconfig"
source "$RTT_DIR/components/hifi4/rtt/rkstudio_comm/Kconfig"
source "$RTT_DIR/components/rkstudio/rtt/rkstudio_parser/Kconfig"
endmenu
```

## rtos/bsp/rockchip/rv1126b-mcu/Image/amp.its
```
/* SPDX-License-Identifier: BSD-3-Clause */
/*
 * Copyright (c) 2025 Rockchip Electronics Co., Ltd.
 */

/dts-v1/;
/ {
	description = "FIT source file for rockchip AMP";
	#address-cells = <1>;

	images {
		hpmcu {
			description  = "hpmcu";
			data         = /incbin/("./rtt.bin");
			type         = "standalone";	// must be "standalone"
			compression  = "none";
			arch         = "arm";	 // "arm64" or "arm"
			load         = <0x48c02000>;
			udelay       = <10000>;
			hash {
				algo = "sha256";
			};
		};
	};

	configurations {
		default = "conf";
		conf {
			description = "Rockchip AMP images";
			rollback-index = <0x0>;
			loadables = "hpmcu";

			signature {
				algo = "sha256,rsa2048";
				padding = "pss";
				key-name-hint = "dev";
				sign-images = "loadables";
			};
		};
	};
};
```

## rtos/bsp/rockchip/rv1126b-mcu/Kconfig
```kconfig
mainmenu "RT-Thread Configuration"

config BSP_DIR
    string
    option env="BSP_ROOT"
    default "."

config RTT_DIR
    string
    option env="RTT_ROOT"
    default "../../.."

config PKGS_DIR
    string
    option env="PKGS_ROOT"
    default "packages"

config BSP_RV1126B
    bool
    select ARCH_RISCV
    default y

source "$RTT_DIR/Kconfig"
source "$BSP_DIR/board/Kconfig"
source "$BSP_DIR/drivers/Kconfig"
source "$BSP_DIR/../common/tests/Kconfig"
source "$RTT_DIR/applications/Kconfig"
```

## rtos/bsp/rockchip/rv1126b-mcu/board/rv1126b_evb1/defconfig
```kconfig
CONFIG_RT_CONFIG_H__=y
CONFIG_BSP_RV1126B=y
CONFIG_RT_USING_CORE_RTTHREAD=y
CONFIG_RT_NAME_MAX=8
CONFIG_RT_USING_TIMER_SOFT=y
CONFIG_RT_TIMER_THREAD_PRIO=4
CONFIG_RT_TIMER_THREAD_STACK_SIZE=512
CONFIG_RT_ALIGN_SIZE=4
CONFIG_RT_THREAD_PRIORITY_32=y
CONFIG_RT_THREAD_PRIORITY_MAX=32
CONFIG_RT_TICK_PER_SECOND=100
CONFIG_RT_USING_OVERFLOW_CHECK=y
CONFIG_RT_USING_HOOK=y
CONFIG_RT_HOOK_USING_FUNC_PTR=y
CONFIG_RT_USING_IDLE_HOOK=y
CONFIG_RT_IDLE_HOOK_LIST_SIZE=4
CONFIG_IDLE_THREAD_STACK_SIZE=256
CONFIG_RT_KSERVICE_USING_STDLIB=y
CONFIG_RT_DEBUG=y
CONFIG_RT_DEBUG_COLOR=y
CONFIG_RT_DEBUG_USING_IO=y
CONFIG_RT_USING_SEMAPHORE=y
CONFIG_RT_USING_MUTEX=y
CONFIG_RT_USING_EVENT=y
CONFIG_RT_USING_MAILBOX=y
CONFIG_RT_USING_MESSAGEQUEUE=y
CONFIG_RT_USING_MEMPOOL=y
CONFIG_RT_USING_SMALL_MEM=y
CONFIG_RT_USING_SMALL_MEM_AS_HEAP=y
CONFIG_RT_USING_HEAP=y
CONFIG_RT_USING_DEVICE=y
CONFIG_RT_USING_CONSOLE=y
CONFIG_RT_CONSOLEBUF_SIZE=128
CONFIG_RT_CONSOLE_DEVICE_NAME="uart4"
CONFIG_RT_VER_NUM=0x40101
CONFIG_ARCH_RISCV=y
CONFIG_RT_USING_COMPONENTS_INIT=y
CONFIG_RT_USING_USER_MAIN=y
CONFIG_RT_MAIN_THREAD_STACK_SIZE=2048
CONFIG_RT_MAIN_THREAD_PRIORITY=10
CONFIG_RT_USING_MSH=y
CONFIG_RT_USING_FINSH=y
CONFIG_FINSH_USING_MSH=y
CONFIG_FINSH_THREAD_NAME="tshell"
CONFIG_FINSH_THREAD_PRIORITY=20
CONFIG_FINSH_THREAD_STACK_SIZE=4096
CONFIG_FINSH_USING_HISTORY=y
CONFIG_FINSH_HISTORY_LINES=5
CONFIG_FINSH_USING_SYMTAB=y
CONFIG_FINSH_CMD_SIZE=80
CONFIG_MSH_USING_BUILT_IN_COMMANDS=y
CONFIG_FINSH_USING_DESCRIPTION=y
CONFIG_FINSH_ARG_MAX=10
CONFIG_RT_USING_DEVICE_IPC=y
CONFIG_RT_USING_SERIAL=y
CONFIG_RT_USING_SERIAL_V1=y
CONFIG_RT_SERIAL_USING_DMA=y
CONFIG_RT_SERIAL_RB_BUFSZ=64
CONFIG_RT_USING_I2C=y
CONFIG_RT_USING_PIN=y
CONFIG_RT_USING_ADC=y
CONFIG_RT_USING_PWM=y
CONFIG_RT_LIBC_DEFAULT_TIMEZONE=8
CONFIG_RT_BOARD_NAME="rv1126b_evb1"
CONFIG_RT_USING_CACHE=y
CONFIG_RT_USING_RPMSG_LITE=y
CONFIG_RT_USING_LINUX_RPMSG=y
CONFIG_RT_USING_CRU=y
CONFIG_RT_USING_MULTI_SARADC=y
CONFIG_RT_USING_UART=y
CONFIG_RT_USING_UART4=y
```

## rtos/bsp/rockchip/rv1126b-mcu/drivers/Kconfig
```kconfig
source "$BSP_DIR/../common/drivers/Kconfig"

menu "RT-Thread rockchip rv1126b drivers"

config RT_USING_CRU
    bool "Enable CRU"
    default n

if RT_USING_I2C
menu "Enable I2C"
    config RT_USING_I2C0
        bool "Enable I2C0"
        default n

    config RT_USING_I2C1
        bool "Enable I2C1"
        default n

    config RT_USING_I2C2
        bool "Enable I2C2"
        default n

    config RT_USING_I2C3
        bool "Enable I2C3"
        default n

    config RT_USING_I2C4
        bool "Enable I2C4"
        default n

    config RT_USING_I2C5
        bool "Enable I2C5"
        default n
endmenu
endif

if RT_USING_PWM
menu "Enable PWM"
    config RT_USING_PWM0
        bool "Enable PWM0"
        default n

    config RT_USING_PWM1
        bool "Enable PWM1"
        default n

    config RT_USING_PWM2
        bool "Enable PWM2"
        default n

    config RT_USING_PWM3
        bool "Enable PWM3"
        default n
endmenu
endif

menu "Enable Multi Saradc"
config RT_USING_MULTI_SARADC
    bool "Enable SARADC"
    select RT_USING_ADC
    default n

    if RT_USING_MULTI_SARADC
        config RT_USING_SARADC0
            bool "Enable Saradc0"
            default n

        config RT_USING_SARADC1
            bool "Enable Saradc1"
            default n

        config RT_USING_SARADC2
            bool "Enable Saradc2"
            default n
    endif
endmenu

menu "Enable UART"
    config RT_USING_UART
        bool "Enable UART"
        default y

    if RT_USING_UART
    config RT_USING_UART0
        bool "Enable UART0"
        default n

    config RT_USING_UART2
        bool "Enable UART2"
        default n

    config RT_USING_UART4
        bool "Enable UART4"
        default n
    endif
endmenu

endmenu
```

## u-boot/board/rockchip/ok3588/Kconfig
```kconfig
if TARGET_OK3588_C

config SYS_BOARD
	default "ok3588"

config SYS_VENDOR
	default "rockchip"

config SYS_CONFIG_NAME
	default "ok3588"

config BOARD_SPECIFIC_OPTIONS # dummy
	def_bool y

config FORLINX_OK3588_LINUX
	bool "Forlinx OK3588-C Linux"
	help
	  Setup for OK3588-C Linux

endif
```
